## boards/sipeed/m1s_dock/m1s_dock_bl808c09q2i_d0_defconfig
```kconfig
# Copyright The Zephyr Project Contributors
#
# SPDX-License-Identifier: Apache-2.0

CONFIG_CONSOLE=n
CONFIG_SERIAL=n
CONFIG_PRINTK=y
CONFIG_XIP=n
```

## boards/sipeed/m1s_dock/m1s_dock_defconfig
```kconfig
# Copyright The Zephyr Project Contributors
#
# SPDX-License-Identifier: Apache-2.0

CONFIG_CONSOLE=y
CONFIG_SERIAL=y

CONFIG_UART_CONSOLE=y

CONFIG_BT_BUF_ACL_TX_COUNT=7
CONFIG_BT_CONN_TX_MAX=7
```

## boards/te_connectivity/smart_badge_2019/Kconfig.defconfig
```kconfig
# Copyright (c) 2025 TE Connectivity
# SPDX-License-Identifier: Apache-2.0

if BOARD_SMART_BADGE_2019

config HW_STACK_PROTECTION
	default ARCH_HAS_STACK_PROTECTION

source "boards/common/usb/Kconfig.cdc_acm_serial.defconfig"

endif # BOARD_SMART_BADGE_2019
```

## boards/te_connectivity/smart_badge_2019/Kconfig.smart_badge_2019
```kconfig
# Copyright (c) 2025 TE Connectivity
# SPDX-License-Identifier: Apache-2.0

config BOARD_SMART_BADGE_2019
	select SOC_NRF52840_QIAA
```

## boards/te_connectivity/smart_badge_2019/board.yml
```yaml
board:
  name: smart_badge_2019
  full_name: TE Connectivity Smart Badge 2019
  vendor: te
  socs:
  - name: nrf52840
```

## boards/te_connectivity/smart_badge_2019/smart_badge_2019_nrf52840_defconfig
```kconfig
# SPDX-License-Identifier: Apache-2.0

# Enable MPU
CONFIG_ARM_MPU=y

# Enable GPIO
CONFIG_GPIO=y

# USB CDC ACM remote wakeup
CONFIG_USB_DEVICE_REMOTE_WAKEUP=n
```

## drivers/audio/Kconfig.bflb_auadc
```kconfig
# Copyright The Zephyr Project Contributors
# SPDX-License-Identifier: Apache-2.0

config AUDIO_DMIC_BFLB_AUADC
	bool "Bouffalo Lab AUADC (Audio ADC/PDM) DMIC driver"
	default y
	depends on DT_HAS_BFLB_AUADC_ENABLED
	select DMA
	help
	  Enable the Bouffalo Lab integrated Audio ADC driver.
	  Supports analog microphone input via PGA and digital
	  PDM microphone input with DMA streaming.

if AUDIO_DMIC_BFLB_AUADC

config DMIC_BFLB_AUADC_QUEUE_SIZE
	int "RX buffer queue depth"
	default 4
	help
	  Number of audio capture buffers that can be queued.

endif # AUDIO_DMIC_BFLB_AUADC
```

## drivers/audio/Kconfig.bflb_audac
```kconfig
# Copyright The Zephyr Project Contributors
# SPDX-License-Identifier: Apache-2.0

config AUDIO_CODEC_BFLB_AUDAC
	bool "Bouffalo Lab AUDAC (Audio DAC) codec driver"
	default y
	depends on DT_HAS_BFLB_AUDAC_ENABLED
	select PINCTRL
	help
	  Enable the Bouffalo Lab integrated Audio DAC driver.
	  Supports PWM and GPDAC output modes with DMA streaming.
```

## drivers/dac/Kconfig.bflb
```kconfig
# Copyright The Zephyr Project Contributors
# SPDX-License-Identifier: Apache-2.0

config DAC_BFLB
	bool "Bouffalo Lab GPDAC driver"
	default y
	depends on DT_HAS_BFLB_GPDAC_ENABLED
	help
	  Enable the Bouffalo Lab General-Purpose DAC (GPDAC) driver.
	  Supports 2 channels with 10-bit resolution. Available on
	  BL602, BL702, BL702L, BL616, BL618.
```

## drivers/i2s/Kconfig.bflb
```kconfig
# Copyright The Zephyr Project Contributors
# SPDX-License-Identifier: Apache-2.0

menuconfig I2S_BFLB
	bool "Bouffalo Lab I2S driver"
	default y
	depends on DT_HAS_BFLB_I2S_ENABLED
	select DMA
	select PINCTRL
	help
	  Enable the I2S driver for Bouffalo Lab SoCs (BL702, BL706,
	  BL616, BL618, BL808). Uses DMA for data transfer.

if I2S_BFLB

config I2S_BFLB_RX_BLOCK_COUNT
	int "RX queue length"
	default 4
	help
	  Length of the RX message queue in number of blocks.

config I2S_BFLB_TX_BLOCK_COUNT
	int "TX queue length"
	default 4
	help
	  Length of the TX message queue in number of blocks.

endif # I2S_BFLB
```

## drivers/ieee802154/Kconfig.bflb
```kconfig
# Bouffalo Lab IEEE 802.15.4 configuration options

# Copyright The Zephyr Project Contributors
# SPDX-License-Identifier: Apache-2.0

menuconfig IEEE802154_BFLB
	bool "Bouffalo Lab IEEE 802.15.4 Driver"
	default y
	depends on DT_HAS_BFLB_IEEE802154_ENABLED
	select DYNAMIC_INTERRUPTS

if IEEE802154_BFLB

config IEEE802154_BFLB_INIT_PRIO
	int "Bouffalo Lab IEEE 802.15.4 initialization priority"
	default 80
	help
	  Set the initialization priority number. Do not mess with it unless
	  you know what you are doing.

config IEEE802154_BFLB_RX_STACK_SIZE
	int "Driver's internal RX thread stack size"
	default 800
	help
	  This option sets the driver's stack size for its internal RX thread.

endif # IEEE802154_BFLB
```

## drivers/memc/Kconfig.bflb
```kconfig
# Copyright (c) 2025 MASSDRIVER EI (massdriver.space)
# SPDX-License-Identifier: Apache-2.0

config MEMC_BFLB_BL61X
	bool "Bouffalolab BL61x PSRAM Controller"
	default y
	depends on DT_HAS_BFLB_BL61X_PSRAM_ENABLED
	depends on SYSCON
	depends on CLOCK_CONTROL
	help
	  Enable Bouffalolab BL61x PSRAM Controller.

config MEMC_BFLB_BL808X
	bool "Bouffalolab BL808x PSRAM Controller"
	default y
	depends on DT_HAS_BFLB_BL808X_PSRAM_ENABLED
	depends on SYSCON
	depends on CLOCK_CONTROL
	help
	  Enable Bouffalolab BL808x PSRAM Controller.
```

## drivers/misc/pec_bflb/Kconfig
```kconfig
# Copyright The Zephyr Project Contributors
# SPDX-License-Identifier: Apache-2.0

config PEC_BFLB
	bool "Bouffalo Lab PEC (programmable I/O) driver"
	default y
	depends on DT_HAS_BFLB_BL61X_PEC_ENABLED
	help
	  Enable the driver for the Bouffalo Lab PEC (Programmable
	  Engine/Controller), a programmable I/O state-machine block on the
	  BL61x SoCs.

if PEC_BFLB

config PEC_BFLB_INIT_PRIORITY
	int "PEC init priority"
	default 40
	help
	  Device initialisation priority for the PEC driver. Must be lower
	  priority (higher number) than the pinctrl and clock-control drivers.

module = PEC_BFLB
module-str = pec_bflb
source "subsys/logging/Kconfig.template.log_config"

endif # PEC_BFLB
```

## drivers/sdhc/Kconfig.bflb_bl808x
```kconfig
# Copyright The Zephyr Project Contributors
# SPDX-License-Identifier: Apache-2.0

config SDHC_BFLB_BL808X
	bool "Bouffalo Lab BL808 SDHC driver"
	default y
	depends on DT_HAS_BFLB_BL808X_SDHC_ENABLED
	select SDHC_SUPPORTS_NATIVE_MODE
	select PINCTRL
	help
	  Enable the Bouffalo Lab BL808 SD Host Controller driver.
	  This is a polling-based PIO driver for initial bring-up.
```

## drivers/sensor/bosch/bmv080/Kconfig
```kconfig
# BMV080 particulate matter sensor configuration

# Copyright The Zephyr Project Contributors
# SPDX-License-Identifier: Apache-2.0

menuconfig BMV080
	bool "BMV080 particulate matter sensor"
	default y
	depends on DT_HAS_BOSCH_BMV080_ENABLED
	depends on I2C
	depends on HAS_BOSCH_BMV080_SDK
	help
	  Enable driver for the Bosch BMV080 particulate matter sensor.
	  The BMV080 measures PM1, PM2.5, and PM10 mass concentrations.
	  This driver requires the proprietary Bosch BMV080 SDK binary
	  libraries (lib_bmv080 and lib_postProcessor).
```

## drivers/sensor/meas/htu21d/Kconfig
```kconfig
# Copyright The Zephyr Project Contributors
# SPDX-License-Identifier: Apache-2.0

config HTU21D
	bool "HTU21D Humidity and Temperature Sensor"
	default y
	depends on DT_HAS_MEAS_HTU21D_ENABLED
	select I2C
	select CRC
	help
	  Enable driver for the TE Connectivity HTU21D digital
	  humidity and temperature sensor over I2C.
```

## drivers/sensor/meas/htu41d/Kconfig
```kconfig
# Copyright The Zephyr Project Contributors
# SPDX-License-Identifier: Apache-2.0

config HTU41D
	bool "HTU41D Humidity and Temperature Sensor"
	default y
	depends on DT_HAS_MEAS_HTU41D_ENABLED
	select I2C
	select CRC
	help
	  Enable driver for the TE Connectivity HTU41D digital
	  humidity and temperature sensor over I2C.
```

## drivers/usb/udc/Kconfig.bflb_bl808x
```kconfig
# Copyright The Zephyr Project Contributors
# SPDX-License-Identifier: Apache-2.0

config UDC_BFLB_BL808X
	bool "Bouffalo Lab BL808x USB device controller driver"
	default y
	depends on DT_HAS_BFLB_BL808X_UDC_ENABLED
	select EVENTS
	select UDC_DRIVER_HAS_HIGH_SPEED_SUPPORT
	help
	  USB 2.0 device controller for BL808x SoCs.
	  The current driver supports high-speed operation and exposes
	  EP0 plus four shared DMA-backed data endpoints.

if UDC_BFLB_BL808X

config UDC_BFLB_BL808X_STACK_SIZE
	int "BL808x UDC driver internal thread stack size"
	default 1024

config UDC_BFLB_BL808X_THREAD_PRIORITY
	int "BL808x UDC driver internal thread priority"
	default 8

config UDC_BFLB_BL808X_EVENT_COUNT
	int "Number of blocks in event slab"
	range 8 32
	default 16

endif # UDC_BFLB_BL808X
```

## drivers/usb/udc/Kconfig.bflb_v2
```kconfig
# Copyright (c) 2024-2026 MASSDRIVER EI (massdriver.space)
# Copyright The Zephyr Project Contributors
# SPDX-License-Identifier: Apache-2.0

config UDC_BFLB_V2
	bool "Bouffalo Lab USB V2 device controller driver"
	default y
	depends on DT_HAS_BFLB_UDC_2_ENABLED
	select UDC_DRIVER_HAS_HIGH_SPEED_SUPPORT
	imply UDC_WORKQUEUE
	help
	  USB 2.0 device controller driver for Bouffalo Lab SoCs
	  with the USB V2 peripheral.
	  Supports high-speed operation and exposes EP0 plus
	  four shared DMA-backed data endpoints.

if UDC_BFLB_V2

choice UDC_BFLB_V2_FIFO_SETUP
	bool "How many FIFOs are used per endpoint"
	default UDC_BFLB_V2_FIFO_BIDIR

config UDC_BFLB_V2_FIFO_MONODIR
	bool "Use a FIFO per endpoint direction"
	help
	  Use one FIFO per endpoint direction: Limits usable endpoints to two.

config UDC_BFLB_V2_FIFO_BIDIR
	bool "Use a FIFO for both endpoint directions"
	help
	  Use a single FIFO for both endpoint direction.

endchoice

config UDC_BFLB_V2_EP1_IN_FIFO_BLOCKS
	int "FIFO blocks buffering endpoint 1 IN"
	depends on UDC_BFLB_V2_FIFO_BIDIR
	range 1 3
	default 1
	help
	  Number of FIFO blocks chained behind endpoint 1 IN, so that the
	  controller fills one block while the host reads another. A bulk
	  stream needs more than one to keep up at high speed. Each block
	  above the first takes the FIFO of the following endpoint, which can
	  then not be used.

config UDC_BFLB_V2_EVENT_COUNT
	int "Number or blocks in event slab"
	range 8 32
	default 16
	help
	  Number of blocks in slab for internal endpoint events.

endif # UDC_BFLB_V2
```

## drivers/video/Kconfig.bflb_camfront
```kconfig
# Copyright The Zephyr Project Contributors
# SPDX-License-Identifier: Apache-2.0

config VIDEO_BFLB_CAMFRONT
	bool "Bouffalo Lab camera front end"
	default y
	depends on DT_HAS_BFLB_CAMFRONT_ENABLED
	select PINCTRL
	help
	  Enable the Bouffalo Lab camera front end, which receives the parallel
	  bus of the sensor and drives its reference clock.

config VIDEO_BFLB_CAMFRONT_CLOCK_INIT_PRIORITY
	int "Camera front end clock and pin muxing initialization priority"
	default 55
	depends on VIDEO_BFLB_CAMFRONT
	help
	  Initialization priority of the sensor reference clock and the camera
	  pins. It must be lower than VIDEO_INIT_PRIORITY so that the clock
	  reaches the sensor before its own initialization talks to it.
```

## drivers/video/Kconfig.bflb_dvp
```kconfig
# Copyright The Zephyr Project Contributors
# SPDX-License-Identifier: Apache-2.0

config VIDEO_BFLB_DVP
	bool "Bouffalo Lab DVP camera interface"
	default y
	depends on DT_HAS_BFLB_DVP_ENABLED
	select PINCTRL
	help
	  Enable the Bouffalo Lab DVP capture interface.

if VIDEO_BFLB_DVP

config VIDEO_BFLB_DVP_CLOCK_INIT_PRIORITY
	int "DVP clock and pin muxing initialization priority"
	default 55
	help
	  Initialization priority of the sensor reference clock and the DVP
	  pins. It must be lower than VIDEO_INIT_PRIORITY so that the clock
	  reaches the sensor before its own initialization talks to it.

config VIDEO_BFLB_DVP_RING_SIZE
	int "Size in bytes of the capture ring"
	default 1228800
	help
	  The controller fills a ring of frames of its own while the frame it
	  completed is copied into the enqueued buffer, so the ring has to hold
	  two frames of the largest format in use. The default is two 640x480
	  YUYV frames.

config VIDEO_BFLB_DVP_RING_ZEPHYR_REGION
	bool "Place the capture ring in a Zephyr memory-region"
	help
	  Place the capture ring in a region created from a
	  'zephyr,memory-region' compatible node, named by
	  VIDEO_BFLB_DVP_RING_ZEPHYR_REGION_NAME. A ring large enough for VGA
	  does not fit in SRAM on most of these parts.

config VIDEO_BFLB_DVP_RING_ZEPHYR_REGION_NAME
	string "Name of the memory-region holding the capture ring"
	depends on VIDEO_BFLB_DVP_RING_ZEPHYR_REGION

config VIDEO_BFLB_DVP_THREAD_STACK_SIZE
	int "Capture thread stack size"
	default 1024
	help
	  Stack size of the thread copying completed frames out of the ring.

config VIDEO_BFLB_DVP_THREAD_PRIORITY
	int "Capture thread priority"
	default 2
	help
	  Cooperative priority of the thread copying completed frames out of
	  the ring. It has one frame period to finish each copy.

endif # VIDEO_BFLB_DVP
```

## drivers/video/Kconfig.bflb_dvp2axi
```kconfig
# Copyright The Zephyr Project Contributors
# SPDX-License-Identifier: Apache-2.0

config VIDEO_BFLB_DVP2AXI
	bool "Bouffalo Lab DVP camera interface"
	default y
	depends on DT_HAS_BFLB_DVP2AXI_ENABLED
	help
	  Enable the Bouffalo Lab DVP capture interface.

if VIDEO_BFLB_DVP2AXI

config VIDEO_BFLB_DVP2AXI_RING_SIZE
	int "Size in bytes of the capture ring"
	default 1228800
	help
	  The controller fills a ring of frames of its own while the frame it
	  completed is copied into the enqueued buffer, so the ring has to hold
	  two frames of the largest format in use. The default is two 640x480
	  YUYV frames.

config VIDEO_BFLB_DVP2AXI_RING_ZEPHYR_REGION
	bool "Place the capture ring in a Zephyr memory-region"
	help
	  Place the capture ring in a region created from a
	  'zephyr,memory-region' compatible node, named by
	  VIDEO_BFLB_DVP2AXI_RING_ZEPHYR_REGION_NAME. A ring large enough for VGA
	  does not fit in SRAM on most of these parts.

config VIDEO_BFLB_DVP2AXI_RING_ZEPHYR_REGION_NAME
	string "Name of the memory-region holding the capture ring"
	depends on VIDEO_BFLB_DVP2AXI_RING_ZEPHYR_REGION

config VIDEO_BFLB_DVP2AXI_THREAD_STACK_SIZE
	int "Capture thread stack size"
	default 1024
	help
	  Stack size of the thread copying completed frames out of the ring.

config VIDEO_BFLB_DVP2AXI_THREAD_PRIORITY
	int "Capture thread priority"
	default 2
	help
	  Cooperative priority of the thread copying completed frames out of
	  the ring. It has one frame period to finish each copy.

endif # VIDEO_BFLB_DVP2AXI
```

## drivers/video/Kconfig.bflb_mjpeg
```kconfig
# Copyright The Zephyr Project Contributors
# SPDX-License-Identifier: Apache-2.0

config VIDEO_BFLB_MJPEG
	bool "Bouffalo Lab MJPEG encoder"
	default y
	depends on DT_HAS_BFLB_MJPEG_ENABLED
	select VIDEO_ENCODER_JPEG
	help
	  Enable the Bouffalo Lab MJPEG encoder, which compresses raw frames
	  held in memory.
```

## drivers/wifi/bflb/Kconfig.bflb
```kconfig
# Copyright The Zephyr Project Contributors
# SPDX-License-Identifier: Apache-2.0

menuconfig WIFI_BFLB
	bool "Bouffalo Lab BL808 WiFi support"
	default y
	depends on DT_HAS_BFLB_BL808X_WIFI_ENABLED
	depends on SOC_SERIES_BL808
	select NET_L2_WIFI_MGMT
	select NET_L2_ETHERNET
	select NET_L2_ETHERNET_MGMT
	select WIFI_USE_NATIVE_NETWORKING
	select DYNAMIC_THREAD
	select DYNAMIC_THREAD_ALLOC
	select HWINFO
	select DYNAMIC_INTERRUPTS
	select CRC
	select MBEDTLS
	select MBEDTLS_MD_C
	select MBEDTLS_PSA_CRYPTO_C
	select PSA_WANT_ALG_SHA_1
	select PSA_WANT_ALG_HMAC
	help
	  Enable Bouffalo Lab BL808 SoC WiFi support.
	  Uses binary blob firmware (libwifi.a) with an open-source
	  host driver.

if WIFI_BFLB

config HEAP_MEM_POOL_ADD_SIZE_BFLB_WIFI
	int
	default 8192
	help
	  System heap for WiFi driver allocations.

endif # WIFI_BFLB
```
