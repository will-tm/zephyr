/*
 * Copyright The Zephyr Project Contributors
 *
 * SPDX-License-Identifier: Apache-2.0
 */

/dts-v1/;

#include <bflb/bl808-lp.dtsi>
#include <zephyr/dt-bindings/pinctrl/bflb-common-pinctrl.h>
#include <zephyr/dt-bindings/pinctrl/bl808x-pinctrl.h>

/ {
	model = "Sipeed M1S Dock LP";
	compatible = "bflb,bl808";

	chosen {
		zephyr,sram = &sram0;
	};
};

&cpu0 {
	clock-frequency = <DT_FREQ_M(80)>;
};
