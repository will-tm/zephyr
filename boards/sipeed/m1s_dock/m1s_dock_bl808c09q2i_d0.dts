/*
 * Copyright The Zephyr Project Contributors
 *
 * SPDX-License-Identifier: Apache-2.0
 */

/dts-v1/;

#include <bflb/bl808-d0.dtsi>
#include "m1s_dock_bl808c09q2i_d0-pinctrl.dtsi"

/ {
	model = "Sipeed M1S Dock D0";
	compatible = "bflb,bl808";

	chosen {
		zephyr,sram = &sram0;
		zephyr,console = &uart3;
		zephyr,shell-uart = &uart3;
	};
};

&cpu0 {
	clock-frequency = <DT_FREQ_M(480)>;
};

&uart3 {
	status = "okay";
	current-speed = <2000000>;

	pinctrl-0 = <&uart3_default>;
	pinctrl-1 = <&uart3_sleep>;
	pinctrl-names = "default", "sleep";
};
