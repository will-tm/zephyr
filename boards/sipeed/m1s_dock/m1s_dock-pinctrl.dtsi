/*
 * Copyright The Zephyr Project Contributors
 *
 * SPDX-License-Identifier: Apache-2.0
 */

#include <dt-bindings/pinctrl/bl808x-pinctrl.h>

&pinctrl {
	white_pwm_pinctrl: white_pwm_pinctrl {
		group1 {
			pinmux = <GPIO8_PWM0_CH0P>;
			bias-pull-up;
			input-schmitt-enable;
			drive-strength = <1>;
		};
	};
};
