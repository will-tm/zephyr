/*
 * SPDX-FileCopyrightText: Copyright The Zephyr Project Contributors
 *
 * SPDX-License-Identifier: Apache-2.0
 */

/ {
	uvc: uvc {
		compatible = "zephyr,uvc-device";
	};
};

zephyr_udc0: &usbd {
	status = "okay";
};
