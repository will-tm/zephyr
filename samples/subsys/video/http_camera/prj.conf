## CMakeLists.txt
```
# SPDX-FileCopyrightText: Copyright The Zephyr Project Contributors
#
# SPDX-License-Identifier: Apache-2.0

cmake_minimum_required(VERSION 3.28.0)

# Local WiFi credentials, kept out of the tree
if(EXISTS ${CMAKE_CURRENT_SOURCE_DIR}/credentials.conf)
  list(APPEND EXTRA_CONF_FILE ${CMAKE_CURRENT_SOURCE_DIR}/credentials.conf)
endif()

find_package(Zephyr REQUIRED HINTS $ENV{ZEPHYR_BASE})
project(http_camera)

target_sources(app PRIVATE
  src/main.c
  src/camera.c
  src/http.c
)

set(gen_dir ${ZEPHYR_BINARY_DIR}/include/generated)
generate_inc_file_for_target(app src/index.html ${gen_dir}/index.html.gz.inc --gzip)
```

## Kconfig
```
# SPDX-FileCopyrightText: Copyright The Zephyr Project Contributors
#
# SPDX-License-Identifier: Apache-2.0

mainmenu "HTTP camera"

config APP_WIFI_SSID
	string "WiFi network name"

config APP_WIFI_PSK
	string "WiFi passphrase"

source "Kconfig.zephyr"
```

## prj.conf
```kconfig
CONFIG_VIDEO=y
CONFIG_VIDEO_SHELL=y
CONFIG_SHELL=y

CONFIG_NETWORKING=y
CONFIG_NET_IPV4=y
CONFIG_NET_IPV6=n
CONFIG_NET_TCP=y
CONFIG_NET_SOCKETS=y
CONFIG_NET_DHCPV4=y
CONFIG_NET_MGMT=y
CONFIG_NET_MGMT_EVENT=y
CONFIG_NET_MGMT_EVENT_INFO=y
CONFIG_NET_CONTEXT_SNDTIMEO=y
CONFIG_NET_MAX_CONTEXTS=12
CONFIG_NET_MAX_CONN=12
CONFIG_ZVFS_OPEN_MAX=16
CONFIG_NET_SHELL=y

CONFIG_WIFI=y
CONFIG_NET_L2_WIFI_SHELL=y

# Room for a stream of large frames in flight
CONFIG_NET_BUF_DATA_SIZE=1536
CONFIG_NET_PKT_TX_COUNT=24
CONFIG_NET_BUF_TX_COUNT=44
CONFIG_NET_PKT_RX_COUNT=8
CONFIG_NET_BUF_RX_COUNT=8
CONFIG_NET_TCP_MAX_SEND_WINDOW_SIZE=24576
CONFIG_NET_TCP_MAX_RECV_WINDOW_SIZE=8192
# The network data buffers only see CPU copies, they live in the PSRAM
CONFIG_NET_BUF_DATA_ZEPHYR_REGION=y
CONFIG_NET_BUF_DATA_ZEPHYR_REGION_NAME="PSRAM"

CONFIG_MAIN_STACK_SIZE=2048

# The WiFi firmware allocates its messages from the libc heap, which otherwise
# only gets the RAM left over
CONFIG_COMMON_LIBC_MALLOC_ARENA_SIZE=16384
# The WiFi connect request runs deep into the supplicant
CONFIG_SYSTEM_WORKQUEUE_STACK_SIZE=4608
CONFIG_LOG=y

# Three capture buffers and the snapshot hold a 1600x1200 JPEG each, the latest
# frame and the frame of each stream a VGA JPEG
CONFIG_VIDEO_BUFFER_POOL_HEAP_SIZE=2097152
CONFIG_VIDEO_BUFFER_POOL_NUM_MAX=7

# JPEG is captured into the ring as a byte stream, a couple of frames is enough
CONFIG_VIDEO_BFLB_DVP2AXI_RING_SIZE=1048576

# Sixteen full size frames in flight to the WiFi firmware
CONFIG_WIFI_BFLB_WIFI6_TX_MAX_PENDING=16
CONFIG_WIFI_BFLB_WIFI6_WRAM_HEAP_SIZE=32768
CONFIG_NET_STATISTICS=y

# Catch stack overflows and report stack usage
CONFIG_STACK_SENTINEL=y
CONFIG_INIT_STACKS=y
CONFIG_THREAD_STACK_INFO=y
CONFIG_THREAD_NAME=y
```

## src/main.c
```c
/*
 * SPDX-FileCopyrightText: Copyright The Zephyr Project Contributors
 *
 * SPDX-License-Identifier: Apache-2.0
 */

#include <string.h>

#include <zephyr/kernel.h>
#include <zephyr/logging/log.h>
#include <zephyr/net/net_if.h>
#include <zephyr/net/dhcpv4.h>
#include <zephyr/net/net_mgmt.h>
#include <zephyr/net/wifi_mgmt.h>

#include "app.h"

LOG_MODULE_REGISTER(main, LOG_LEVEL_INF);

#define WIFI_EVENTS (NET_EVENT_WIFI_CONNECT_RESULT | NET_EVENT_WIFI_DISCONNECT_RESULT)
#define RECONNECT_DELAY K_SECONDS(5)

static struct net_mgmt_event_callback wifi_cb;
static struct net_mgmt_event_callback ipv4_cb;
static struct net_if *iface;

static void wifi_connect(struct k_work *work)
{
	struct wifi_connect_req_params params = {
		.ssid = CONFIG_APP_WIFI_SSID,
		.ssid_length = sizeof(CONFIG_APP_WIFI_SSID) - 1,
		.psk = CONFIG_APP_WIFI_PSK,
		.psk_length = sizeof(CONFIG_APP_WIFI_PSK) - 1,
		.security = WIFI_SECURITY_TYPE_PSK,
		.channel = WIFI_CHANNEL_ANY,
		.band = WIFI_FREQ_BAND_UNKNOWN,
		.mfp = WIFI_MFP_OPTIONAL,
		.timeout = SYS_FOREVER_MS,
	};
	int ret;

	LOG_INF("Connecting to \"%s\"", CONFIG_APP_WIFI_SSID);
	ret = net_mgmt(NET_REQUEST_WIFI_CONNECT, iface, &params, sizeof(params));
	if (ret < 0) {
		LOG_ERR("Connect request failed (%d)", ret);
		k_work_reschedule(k_work_delayable_from_work(work), RECONNECT_DELAY);
	}
}

static K_WORK_DELAYABLE_DEFINE(connect_work, wifi_connect);

static void wifi_event(struct net_mgmt_event_callback *cb, uint64_t event, struct net_if *ifc)
{
	const struct wifi_status *status = cb->info;

	if (event == NET_EVENT_WIFI_CONNECT_RESULT && status->status == 0) {
		LOG_INF("Connected");
		return;
	}

	LOG_WRN("%s (%d), retrying", event == NET_EVENT_WIFI_CONNECT_RESULT ?
		"Connection failed" : "Disconnected", status->status);
	k_work_reschedule(&connect_work, RECONNECT_DELAY);
}

static void ipv4_event(struct net_mgmt_event_callback *cb, uint64_t event, struct net_if *ifc)
{
	char addr[NET_IPV4_ADDR_LEN];

	for (int i = 0; i < NET_IF_MAX_IPV4_ADDR; i++) {
		struct net_if_addr *ifaddr = &ifc->config.ip.ipv4->unicast[i].ipv4;

		if (ifaddr->is_used && ifaddr->addr_type == NET_ADDR_DHCP) {
			net_addr_ntop(NET_AF_INET, &ifaddr->address.in_addr, addr, sizeof(addr));
			LOG_INF("Camera at http://%s/", addr);
		}
	}
}

int main(void)
{
	int ret;

	ret = camera_start();
	if (ret < 0) {
		return ret;
	}

	ret = http_start();
	if (ret < 0) {
		return ret;
	}

	iface = net_if_get_wifi_sta();
	if (iface == NULL) {
		LOG_ERR("No WiFi interface");
		return -ENODEV;
	}

	net_mgmt_init_event_callback(&wifi_cb, wifi_event, WIFI_EVENTS);
	net_mgmt_add_event_callback(&wifi_cb);
	net_mgmt_init_event_callback(&ipv4_cb, ipv4_event, NET_EVENT_IPV4_ADDR_ADD);
	net_mgmt_add_event_callback(&ipv4_cb);

	net_dhcpv4_start(iface);
	k_work_reschedule(&connect_work, K_NO_WAIT);

	return 0;
}

void wifi_get_status(int *rssi, uint32_t *phy_x10, uint32_t *channel)
{
	struct wifi_iface_status status = {0};

	if (iface == NULL ||
	    net_mgmt(NET_REQUEST_WIFI_IFACE_STATUS, iface, &status, sizeof(status)) < 0 ||
	    status.state < WIFI_STATE_ASSOCIATED) {
		*rssi = 0;
		*phy_x10 = 0;
		*channel = 0;
		return;
	}

	*rssi = status.rssi;
	*phy_x10 = (uint32_t)(status.current_phy_tx_rate * 10.0f);
	*channel = status.channel;
}
```

## src/app.h
```c
/*
 * SPDX-FileCopyrightText: Copyright The Zephyr Project Contributors
 *
 * SPDX-License-Identifier: Apache-2.0
 */

#ifndef APP_H_
#define APP_H_

#include <stddef.h>
#include <stdint.h>

#include <zephyr/kernel.h>

#define STREAM_WIDTH    640
#define STREAM_HEIGHT   480
#define SNAPSHOT_WIDTH  1600
#define SNAPSHOT_HEIGHT 1200

/* Largest streamed frame, a larger one is dropped */
#define STREAM_FRAME_MAX 131072

#define MAX_STREAMS 2

/* JPEG quantization scale of the sensor, lower is finer */
#define QS_MIN 5
#define QS_MAX 63

struct camera_settings {
	int32_t stream_qs;
	int32_t photo_qs;
	/* Sensor levels, -2 to 2 */
	int32_t contrast;
	int32_t brightness;
	int32_t saturation;
};

struct camera_stats {
	uint32_t width;
	uint32_t height;
	/* Over the last second */
	uint32_t fps_x10;
	uint32_t interval_us;
	uint32_t jitter_us;
	uint32_t frame_avg;
	uint32_t frame_max;
	/* Since boot */
	uint32_t frames;
	uint32_t bytes;
	uint32_t dropped;
	uint32_t snapshots;
	uint32_t snap_size;
	uint32_t snap_pause_ms;
};

int camera_start(void);
void camera_get_stats(struct camera_stats *stats);
void camera_get_settings(struct camera_settings *settings);
/* Apply settings from the camera thread, before its next frame */
int camera_set_settings(const struct camera_settings *settings);

/* Copy the next frame after *seq into buf, waiting for it up to timeout */
int camera_frame_copy(uint8_t *buf, size_t size, size_t *len, uint32_t *seq, k_timeout_t timeout);

/* Take a full resolution picture, valid until camera_snapshot_release() */
int camera_snapshot(const uint8_t **data, size_t *len);
void camera_snapshot_release(void);

int http_start(void);
void wifi_get_status(int *rssi, uint32_t *phy_x10, uint32_t *channel);

#endif /* APP_H_ */
```

## src/camera.c
```c
/*
 * SPDX-FileCopyrightText: Copyright The Zephyr Project Contributors
 *
 * SPDX-License-Identifier: Apache-2.0
 */

#include <math.h>
#include <string.h>

#include <zephyr/device.h>
#include <zephyr/kernel.h>
#include <zephyr/logging/log.h>
#include <zephyr/sys/atomic.h>
#include <zephyr/video/video.h>

#include "app.h"

LOG_MODULE_REGISTER(camera, LOG_LEVEL_INF);

#define CAPTURE_BUFS  3
/* Frames the sensor takes to apply the exposure carried over to full resolution */
#define SNAPSHOT_SKIP 6

#define LOG_PERIOD    K_SECONDS(60)

static const struct device *const video_dev = DEVICE_DT_GET(DT_CHOSEN(zephyr_camera));

static struct video_buffer *latest;
static size_t latest_len;
static uint32_t latest_seq;
static K_MUTEX_DEFINE(frame_lock);
static K_CONDVAR_DEFINE(frame_cond);

static struct video_buffer *snap;
static size_t snap_len;
static int snap_ret;
static K_MUTEX_DEFINE(snap_lock);
static K_SEM_DEFINE(snap_req, 0, 1);
static K_SEM_DEFINE(snap_done, 0, 1);

static struct camera_stats stats;
static K_MUTEX_DEFINE(stats_lock);

static struct camera_settings settings = {
	.stream_qs = 8,
	.photo_qs = 5,
};
static struct camera_settings pending;
static K_MUTEX_DEFINE(settings_lock);
static atomic_t settings_dirty;

/* Frame intervals of the second being measured */
static struct {
	int64_t start_us;
	int64_t last_us;
	uint32_t frames;
	uint64_t sum;
	uint64_t sum_sq;
	uint32_t bytes;
	uint32_t max;
} window;

static K_THREAD_STACK_DEFINE(camera_stack, 2048);
static struct k_thread camera_thread;

static int set_size(uint32_t width, uint32_t height, size_t *size)
{
	struct video_format fmt = {
		.type = VIDEO_BUF_TYPE_OUTPUT,
		.pixelformat = VIDEO_PIX_FMT_JPEG,
		.width = width,
		.height = height,
	};
	int ret;

	ret = video_set_format(video_dev, &fmt);
	if (ret < 0) {
		LOG_ERR("Cannot set %ux%u JPEG (%d)", width, height, ret);
		return ret;
	}

	if (size != NULL) {
		*size = fmt.size;
	}

	return 0;
}

/* Restart the stream at another size, with every buffer queued again */
static int switch_size(uint32_t width, uint32_t height)
{
	struct video_buffer *vbuf;
	int ret;

	video_stream_stop(video_dev, VIDEO_BUF_TYPE_OUTPUT);
	while (video_dequeue(video_dev, &vbuf, K_NO_WAIT) == 0) {
		video_enqueue(video_dev, vbuf);
	}

	ret = set_size(width, height, NULL);
	if (ret < 0) {
		return ret;
	}

	return video_stream_start(video_dev, VIDEO_BUF_TYPE_OUTPUT);
}

static void publish(const struct video_buffer *vbuf)
{
	if (vbuf->bytesused > latest->size) {
		LOG_WRN("Dropped a %u byte frame", vbuf->bytesused);
		stats.dropped++;
		return;
	}

	k_mutex_lock(&frame_lock, K_FOREVER);
	memcpy(latest->buffer, vbuf->buffer, vbuf->bytesused);
	latest_len = vbuf->bytesused;
	latest_seq++;
	k_condvar_broadcast(&frame_cond);
	k_mutex_unlock(&frame_lock);
}

static void set_ctrl(uint32_t id, int32_t val)
{
	struct video_control ctrl = {.id = id, .val = val};
	int ret;

	ret = video_set_ctrl(video_dev, &ctrl);
	if (ret < 0) {
		LOG_WRN("Cannot set control 0x%x to %d (%d)", id, val, ret);
	}
}

static void apply_settings(void)
{
	k_mutex_lock(&settings_lock, K_FOREVER);
	settings = pending;
	k_mutex_unlock(&settings_lock);

	/* The control holds the quantization scale itself */
	set_ctrl(VIDEO_CID_JPEG_COMPRESSION_QUALITY, settings.stream_qs);
	set_ctrl(VIDEO_CID_CONTRAST, settings.contrast);
	set_ctrl(VIDEO_CID_BRIGHTNESS, settings.brightness);
	set_ctrl(VIDEO_CID_SATURATION, settings.saturation);
}

/* Hold the exposure and gain of the stream, which the sensor carries over to the snapshot */
static void set_auto_exposure(bool enable)
{
	set_ctrl(VIDEO_CID_EXPOSURE, enable ? 1 : 0);
	set_ctrl(VIDEO_CID_GAIN, enable ? 1 : 0);
	set_ctrl(VIDEO_CID_WHITE_BALANCE_TEMPERATURE, enable ? 1 : 0);
}

static int take_snapshot(void)
{
	struct video_buffer *vbuf;
	int ret;

	set_auto_exposure(false);
	set_ctrl(VIDEO_CID_JPEG_COMPRESSION_QUALITY, settings.photo_qs);

	ret = switch_size(SNAPSHOT_WIDTH, SNAPSHOT_HEIGHT);
	if (ret < 0) {
		set_ctrl(VIDEO_CID_JPEG_COMPRESSION_QUALITY, settings.stream_qs);
		set_auto_exposure(true);
		return ret;
	}

	snap_len = 0;
	for (int i = 0; i <= SNAPSHOT_SKIP; i++) {
		ret = video_dequeue(video_dev, &vbuf, K_SECONDS(1));
		if (ret < 0) {
			LOG_ERR("No snapshot frame (%d)", ret);
			break;
		}

		if (i == SNAPSHOT_SKIP && vbuf->bytesused <= snap->size) {
			memcpy(snap->buffer, vbuf->buffer, vbuf->bytesused);
			snap_len = vbuf->bytesused;
		}

		video_enqueue(video_dev, vbuf);
	}

	if (switch_size(STREAM_WIDTH, STREAM_HEIGHT) < 0) {
		LOG_ERR("Cannot restore the stream");
	}

	set_ctrl(VIDEO_CID_JPEG_COMPRESSION_QUALITY, settings.stream_qs);
	set_auto_exposure(true);

	return snap_len > 0 ? 0 : -EIO;
}

static void account(uint32_t size)
{
	int64_t now = k_ticks_to_us_floor64(k_uptime_ticks());
	uint64_t interval;
	double mean;

	if (window.last_us != 0) {
		interval = now - window.last_us;
		window.frames++;
		window.sum += interval;
		window.sum_sq += interval * interval;
		window.bytes += size;
		window.max = MAX(window.max, size);
	} else {
		window.start_us = now;
	}
	window.last_us = now;

	k_mutex_lock(&stats_lock, K_FOREVER);
	stats.frames++;
	stats.bytes += size;

	if (now - window.start_us >= USEC_PER_SEC && window.frames > 0) {
		mean = (double)window.sum / window.frames;
		stats.fps_x10 = (uint32_t)(10.0 * USEC_PER_SEC / mean + 0.5);
		stats.interval_us = (uint32_t)mean;
		stats.jitter_us = (uint32_t)sqrt(MAX((double)window.sum_sq / window.frames -
						     mean * mean, 0.0));
		stats.frame_avg = window.bytes / window.frames;
		stats.frame_max = window.max;

		window.start_us = now;
		window.frames = 0;
		window.sum = 0;
		window.sum_sq = 0;
		window.bytes = 0;
		window.max = 0;
	}
	k_mutex_unlock(&stats_lock);
}

static void camera_run(void *p1, void *p2, void *p3)
{
	k_timepoint_t next_log = sys_timepoint_calc(LOG_PERIOD);
	int64_t paused = 0;
	struct video_buffer *vbuf;

	for (;;) {
		if (atomic_cas(&settings_dirty, 1, 0)) {
			apply_settings();
		}

		if (k_sem_take(&snap_req, K_NO_WAIT) == 0) {
			paused = k_uptime_get();
			snap_ret = take_snapshot();
			k_sem_give(&snap_done);
		}

		if (video_dequeue(video_dev, &vbuf, K_MSEC(100)) < 0) {
			continue;
		}

		if (paused != 0) {
			k_mutex_lock(&stats_lock, K_FOREVER);
			stats.snapshots++;
			stats.snap_size = snap_len;
			stats.snap_pause_ms = k_uptime_get() - paused;
			k_mutex_unlock(&stats_lock);
			LOG_INF("Snapshot of %zu bytes, stream paused for %u ms", snap_len,
				stats.snap_pause_ms);
			/* Keep the pause out of the frame interval statistics */
			window.last_us = 0;
			window.frames = 0;
			window.sum = 0;
			window.sum_sq = 0;
			window.bytes = 0;
			window.max = 0;
			paused = 0;
		}

		if (vbuf->bytesused > 0) {
			publish(vbuf);
			account(vbuf->bytesused);
		}

		video_enqueue(video_dev, vbuf);

		if (sys_timepoint_expired(next_log)) {
			LOG_INF("%u.%u fps, %u bytes per frame", stats.fps_x10 / 10,
				stats.fps_x10 % 10, stats.frame_avg);
			next_log = sys_timepoint_calc(LOG_PERIOD);
		}
	}
}

void camera_get_settings(struct camera_settings *out)
{
	k_mutex_lock(&settings_lock, K_FOREVER);
	*out = atomic_get(&settings_dirty) != 0 ? pending : settings;
	k_mutex_unlock(&settings_lock);
}

int camera_set_settings(const struct camera_settings *in)
{
	if (!IN_RANGE(in->stream_qs, QS_MIN, QS_MAX) || !IN_RANGE(in->photo_qs, QS_MIN, QS_MAX) ||
	    !IN_RANGE(in->contrast, -2, 2) || !IN_RANGE(in->brightness, -2, 2) ||
	    !IN_RANGE(in->saturation, -2, 2)) {
		return -EINVAL;
	}

	k_mutex_lock(&settings_lock, K_FOREVER);
	pending = *in;
	atomic_set(&settings_dirty, 1);
	k_mutex_unlock(&settings_lock);

	return 0;
}

void camera_get_stats(struct camera_stats *out)
{
	k_mutex_lock(&stats_lock, K_FOREVER);
	*out = stats;
	k_mutex_unlock(&stats_lock);
}

int camera_frame_copy(uint8_t *buf, size_t size, size_t *len, uint32_t *seq, k_timeout_t timeout)
{
	k_mutex_lock(&frame_lock, K_FOREVER);

	while (latest_seq == *seq) {
		if (k_condvar_wait(&frame_cond, &frame_lock, timeout) < 0) {
			k_mutex_unlock(&frame_lock);
			return -EAGAIN;
		}
	}

	*len = MIN(latest_len, size);
	memcpy(buf, latest->buffer, *len);
	*seq = latest_seq;

	k_mutex_unlock(&frame_lock);

	return 0;
}

int camera_snapshot(const uint8_t **data, size_t *len)
{
	k_mutex_lock(&snap_lock, K_FOREVER);
	k_sem_give(&snap_req);
	k_sem_take(&snap_done, K_FOREVER);

	if (snap_ret < 0) {
		k_mutex_unlock(&snap_lock);
		return snap_ret;
	}

	*data = snap->buffer;
	*len = snap_len;

	return 0;
}

void camera_snapshot_release(void)
{
	k_mutex_unlock(&snap_lock);
}

int camera_start(void)
{
	struct video_buffer *vbuf;
	size_t size;
	int ret;

	if (!device_is_ready(video_dev)) {
		LOG_ERR("%s not ready", video_dev->name);
		return -ENODEV;
	}

	/* Every capture buffer has to hold a snapshot frame */
	ret = set_size(SNAPSHOT_WIDTH, SNAPSHOT_HEIGHT, &size);
	if (ret < 0) {
		return ret;
	}

	snap = video_buffer_alloc(size, K_NO_WAIT);
	latest = video_buffer_alloc(STREAM_FRAME_MAX, K_NO_WAIT);
	if (snap == NULL || latest == NULL) {
		LOG_ERR("Cannot allocate frame buffers");
		return -ENOMEM;
	}

	for (int i = 0; i < CAPTURE_BUFS; i++) {
		vbuf = video_buffer_alloc(size, K_NO_WAIT);
		if (vbuf == NULL) {
			LOG_ERR("Cannot allocate capture buffers");
			return -ENOMEM;
		}

		vbuf->type = VIDEO_BUF_TYPE_OUTPUT;
		video_enqueue(video_dev, vbuf);
	}

	ret = set_size(STREAM_WIDTH, STREAM_HEIGHT, NULL);
	if (ret < 0) {
		return ret;
	}

	pending = settings;
	apply_settings();

	stats.width = STREAM_WIDTH;
	stats.height = STREAM_HEIGHT;

	ret = video_stream_start(video_dev, VIDEO_BUF_TYPE_OUTPUT);
	if (ret < 0) {
		LOG_ERR("Cannot start the stream (%d)", ret);
		return ret;
	}

	k_thread_create(&camera_thread, camera_stack, K_THREAD_STACK_SIZEOF(camera_stack),
			camera_run, NULL, NULL, NULL, K_PRIO_PREEMPT(5), 0, K_NO_WAIT);
	k_thread_name_set(&camera_thread, "camera");

	return 0;
}
```

## src/http.c
```c
/*
 * SPDX-FileCopyrightText: Copyright The Zephyr Project Contributors
 *
 * SPDX-License-Identifier: Apache-2.0
 */

#include <stdio.h>
#include <stdlib.h>
#include <string.h>

#include <zephyr/kernel.h>
#include <zephyr/logging/log.h>
#include <zephyr/net/socket.h>
#include <zephyr/sys/atomic.h>
#include <zephyr/video/video.h>

#include "app.h"

LOG_MODULE_REGISTER(http, LOG_LEVEL_INF);

#define HTTP_PORT 80

/* One more worker than streams, so that the page and snapshots are always served */
#define WORKERS      (MAX_STREAMS + 1)
#define STACK_SIZE   4096
#define REQUEST_SIZE 512

#define BOUNDARY "frame"

static const uint8_t index_html_gz[] = {
#include "index.html.gz.inc"
};

static atomic_t sent;
static atomic_t streams;

K_MSGQ_DEFINE(client_q, sizeof(int), WORKERS, 4);
static K_THREAD_STACK_ARRAY_DEFINE(worker_stacks, WORKERS, STACK_SIZE);
static struct k_thread workers[WORKERS];
static K_THREAD_STACK_DEFINE(accept_stack, 2048);
static struct k_thread accept_thread;

static int send_all(int fd, const void *buf, size_t len)
{
	const uint8_t *p = buf;
	ssize_t ret;

	while (len > 0) {
		ret = zsock_send(fd, p, len, 0);
		if (ret < 0) {
			return -errno;
		}

		atomic_add(&sent, ret);
		p += ret;
		len -= ret;
	}

	return 0;
}

static int send_str(int fd, const char *s)
{
	return send_all(fd, s, strlen(s));
}

static void send_status(int fd, const char *status)
{
	char head[128];

	snprintf(head, sizeof(head),
		 "HTTP/1.1 %s\r\nContent-Length: 0\r\nConnection: close\r\n\r\n", status);
	send_str(fd, head);
}

static void serve_index(int fd)
{
	char head[160];

	snprintf(head, sizeof(head),
		 "HTTP/1.1 200 OK\r\nContent-Type: text/html\r\nContent-Encoding: gzip\r\n"
		 "Content-Length: %u\r\nConnection: close\r\n\r\n",
		 sizeof(index_html_gz));
	if (send_str(fd, head) == 0) {
		send_all(fd, index_html_gz, sizeof(index_html_gz));
	}
}

static void serve_stats(int fd)
{
	struct camera_settings cs;
	struct camera_stats st;
	char body[512];
	char head[128];
	uint32_t channel;
	uint32_t phy;
	int rssi;
	int len;

	camera_get_stats(&st);
	camera_get_settings(&cs);
	wifi_get_status(&rssi, &phy, &channel);

	len = snprintf(body, sizeof(body),
		       "{\"uptime\":%u,\"width\":%u,\"height\":%u,"
		       "\"stream_qs\":%d,\"photo_qs\":%d,\"contrast\":%d,\"brightness\":%d,"
		       "\"saturation\":%d,\"fps\":%u.%u,\"interval_us\":%u,\"jitter_us\":%u,"
		       "\"frame_avg\":%u,\"frame_max\":%u,\"frames\":%u,\"bytes\":%u,"
		       "\"dropped\":%u,\"snapshots\":%u,\"snap_size\":%u,\"snap_pause_ms\":%u,"
		       "\"streams\":%d,\"sent\":%u,\"rssi\":%d,\"phy\":%u.%u,\"channel\":%u}",
		       k_uptime_seconds(), st.width, st.height, cs.stream_qs, cs.photo_qs,
		       cs.contrast, cs.brightness, cs.saturation, st.fps_x10 / 10, st.fps_x10 % 10,
		       st.interval_us, st.jitter_us, st.frame_avg, st.frame_max, st.frames,
		       st.bytes, st.dropped, st.snapshots, st.snap_size, st.snap_pause_ms,
		       (int)atomic_get(&streams), (uint32_t)atomic_get(&sent), rssi, phy / 10,
		       phy % 10, channel);

	snprintf(head, sizeof(head),
		 "HTTP/1.1 200 OK\r\nContent-Type: application/json\r\n"
		 "Cache-Control: no-store\r\nContent-Length: %d\r\nConnection: close\r\n\r\n",
		 len);
	if (send_str(fd, head) == 0) {
		send_all(fd, body, len);
	}
}

/* Take the settings given as key=value pairs, the others stay as they are */
static void serve_set(int fd, char *query)
{
	struct camera_settings cs;
	char *pair;
	char *save;
	char *val;
	int32_t v;

	camera_get_settings(&cs);

	for (pair = strtok_r(query, "&", &save); pair != NULL; pair = strtok_r(NULL, "&", &save)) {
		val = strchr(pair, '=');
		if (val == NULL) {
			continue;
		}
		*val++ = '\0';
		v = strtol(val, NULL, 10);

		if (strcmp(pair, "stream_qs") == 0) {
			cs.stream_qs = v;
		} else if (strcmp(pair, "photo_qs") == 0) {
			cs.photo_qs = v;
		} else if (strcmp(pair, "contrast") == 0) {
			cs.contrast = v;
		} else if (strcmp(pair, "brightness") == 0) {
			cs.brightness = v;
		} else if (strcmp(pair, "saturation") == 0) {
			cs.saturation = v;
		}
	}

	if (camera_set_settings(&cs) < 0) {
		send_status(fd, "400 Bad Request");
		return;
	}

	serve_stats(fd);
}

static void serve_stream(int fd)
{
	struct video_buffer *vbuf;
	uint32_t seq = 0;
	char head[96];
	size_t len;
	int ret;

	if (atomic_inc(&streams) >= MAX_STREAMS) {
		send_status(fd, "503 Service Unavailable");
		goto out;
	}

	vbuf = video_buffer_alloc(STREAM_FRAME_MAX, K_NO_WAIT);
	if (vbuf == NULL) {
		send_status(fd, "503 Service Unavailable");
		goto out;
	}

	ret = send_str(fd, "HTTP/1.1 200 OK\r\n"
			   "Content-Type: multipart/x-mixed-replace; boundary=" BOUNDARY "\r\n"
			   "Cache-Control: no-cache\r\nConnection: close\r\n\r\n");

	while (ret == 0) {
		ret = camera_frame_copy(vbuf->buffer, vbuf->size, &len, &seq, K_SECONDS(5));
		if (ret < 0) {
			LOG_WRN("No frame for 5 s");
			ret = 0;
			continue;
		}

		snprintf(head, sizeof(head),
			 "--" BOUNDARY "\r\nContent-Type: image/jpeg\r\nContent-Length: %u\r\n\r\n",
			 len);
		ret = send_str(fd, head);
		if (ret == 0) {
			ret = send_all(fd, vbuf->buffer, len);
		}
		if (ret == 0) {
			ret = send_str(fd, "\r\n");
		}
	}

	video_buffer_release(vbuf);
out:
	atomic_dec(&streams);
}

static void serve_snapshot(int fd)
{
	const uint8_t *data;
	char head[192];
	size_t len;
	int ret;

	ret = camera_snapshot(&data, &len);
	if (ret < 0) {
		send_status(fd, "500 Internal Server Error");
		return;
	}

	snprintf(head, sizeof(head),
		 "HTTP/1.1 200 OK\r\nContent-Type: image/jpeg\r\nContent-Length: %u\r\n"
		 "Cache-Control: no-store\r\nConnection: close\r\n\r\n",
		 len);
	if (send_str(fd, head) == 0) {
		send_all(fd, data, len);
	}

	camera_snapshot_release();
}

static void serve(int fd)
{
	char req[REQUEST_SIZE];
	char *query = "";
	size_t used = 0;
	char *path;
	char *end;
	ssize_t ret;

	/* Only the request line matters, read until the end of the headers */
	do {
		ret = zsock_recv(fd, req + used, sizeof(req) - 1 - used, 0);
		if (ret <= 0) {
			return;
		}

		used += ret;
		req[used] = '\0';
	} while (strstr(req, "\r\n\r\n") == NULL && used < sizeof(req) - 1);

	if (strncmp(req, "GET ", 4) != 0) {
		send_status(fd, "405 Method Not Allowed");
		return;
	}

	path = req + 4;
	end = strpbrk(path, " \r\n");
	if (end == NULL) {
		send_status(fd, "400 Bad Request");
		return;
	}
	*end = '\0';

	end = strchr(path, '?');
	if (end != NULL) {
		*end = '\0';
		query = end + 1;
	}

	LOG_DBG("GET %s", path);

	if (strcmp(path, "/") == 0) {
		serve_index(fd);
	} else if (strcmp(path, "/stream") == 0) {
		serve_stream(fd);
	} else if (strcmp(path, "/stats") == 0) {
		serve_stats(fd);
	} else if (strcmp(path, "/set") == 0) {
		serve_set(fd, query);
	} else if (strcmp(path, "/snapshot.jpg") == 0) {
		serve_snapshot(fd);
	} else {
		send_status(fd, "404 Not Found");
	}
}

static void worker_run(void *p1, void *p2, void *p3)
{
	struct timeval timeout = {.tv_sec = 10};
	int fd;

	for (;;) {
		k_msgq_get(&client_q, &fd, K_FOREVER);

		zsock_setsockopt(fd, ZSOCK_SOL_SOCKET, ZSOCK_SO_SNDTIMEO, &timeout,
				 sizeof(timeout));
		zsock_setsockopt(fd, ZSOCK_SOL_SOCKET, ZSOCK_SO_RCVTIMEO, &timeout,
				 sizeof(timeout));
		serve(fd);
		zsock_close(fd);
	}
}

static void accept_run(void *p1, void *p2, void *p3)
{
	struct net_sockaddr_in addr = {
		.sin_family = NET_AF_INET,
		.sin_port = net_htons(HTTP_PORT),
	};
	struct timeval busy_timeout = {.tv_sec = 1};
	int one = 1;
	int server;
	int fd;

	server = zsock_socket(NET_AF_INET, NET_SOCK_STREAM, NET_IPPROTO_TCP);
	if (server < 0) {
		LOG_ERR("Cannot create the server socket (%d)", errno);
		return;
	}

	zsock_setsockopt(server, ZSOCK_SOL_SOCKET, ZSOCK_SO_REUSEADDR, &one, sizeof(one));

	if (zsock_bind(server, (struct net_sockaddr *)&addr, sizeof(addr)) < 0 ||
	    zsock_listen(server, WORKERS) < 0) {
		LOG_ERR("Cannot listen on port %d (%d)", HTTP_PORT, errno);
		zsock_close(server);
		return;
	}

	for (;;) {
		fd = zsock_accept(server, NULL, NULL);
		if (fd < 0) {
			LOG_ERR("Accept failed (%d)", errno);
			continue;
		}

		if (k_msgq_put(&client_q, &fd, K_NO_WAIT) < 0) {
			zsock_setsockopt(fd, ZSOCK_SOL_SOCKET, ZSOCK_SO_SNDTIMEO, &busy_timeout,
					 sizeof(busy_timeout));
			send_status(fd, "503 Service Unavailable");
			zsock_close(fd);
		}
	}
}

int http_start(void)
{
	for (int i = 0; i < WORKERS; i++) {
		k_thread_create(&workers[i], worker_stacks[i], STACK_SIZE, worker_run, NULL, NULL,
				NULL, K_PRIO_PREEMPT(8), 0, K_NO_WAIT);
		k_thread_name_set(&workers[i], "http_worker");
	}

	k_thread_create(&accept_thread, accept_stack, K_THREAD_STACK_SIZEOF(accept_stack),
			accept_run, NULL, NULL, NULL, K_PRIO_PREEMPT(8), 0, K_NO_WAIT);
	k_thread_name_set(&accept_thread, "http");

	return 0;
}
```
