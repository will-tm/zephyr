## dts/bindings/wifi/bflb,bl808x-wifi.yaml
```yaml
# Copyright The Zephyr Project Contributors
#
# SPDX-License-Identifier: Apache-2.0

description: Bouffalo Lab BL808 WiFi controller

compatible: "bflb,bl808x-wifi"

include: base.yaml

properties:
  reg:
    required: true

  interrupts:
    required: true
```

## modules/hal_bosch/Kconfig
```kconfig
# Copyright The Zephyr Project Contributors
# SPDX-License-Identifier: Apache-2.0

config HAS_BOSCH_BMV080_SDK
	bool
	default y if CPU_CORTEX_M0PLUS
	default y if CPU_CORTEX_M4
	default y if CPU_CORTEX_M7 && FPU
	default y if CPU_CORTEX_M33
	default y if RISCV
	default y if SOC_SERIES_ESP32
	default y if SOC_SERIES_ESP32S2
	default y if SOC_SERIES_ESP32S3
	help
	  Set if the Bosch BMV080 SDK binary libraries are available
	  for the current architecture.
```

## modules/hal_bouffalolab/Kconfig
```kconfig
# Copyright (c) 2021-2025 Gerson Fernando Budke <nandojve@gmail.com>
# Copyright (c) 2024-2025 MASSDRIVER EI (massdriver.space)
#
# SPDX-License-Identifier: Apache-2.0

config ZEPHYR_HAL_BOUFFALOLAB_MODULE
	bool

config BFLB_FREERTOS_SHIM
	bool
	help
	  FreeRTOS-to-Zephyr shim for Bouffalo Lab BLE controller blobs.
	  Selected by SoC-specific BLE drivers that need it.

config BFLB_BTBLE_TASK_PRIO
	int "BLE controller task priority"
	default 5
	depends on BFLB_FREERTOS_SHIM
	help
	  Priority level reported to the BLE controller blob via the
	  FreeRTOS shim uxTaskPriorityGet() function.

config BFLB_BTBLE_PORT_OS_SHIM
	bool
	help
	  Zephyr RTOS port for the btblecontroller binary blob.
	  Implements the btblecontroller_* OS abstraction for BL702L/BL616.
	  Selected by SoC-specific BLE drivers that use the btblecontroller API.

config BFLB_SHIM_HEAP_SIZE
	int "BLE shim heap size"
	default 8192
	depends on BFLB_FREERTOS_SHIM || BFLB_BTBLE_PORT_OS_SHIM
	help
	  Size in bytes of the dedicated memory pool used by the BLE
	  controller shim layer for threads, stacks, and queues.

menuconfig BFLB_ZIGBEE
	bool "Bouffalo Lab Zigbee stack"
	depends on SOC_SERIES_BL70XL
	select BFLB_FREERTOS_SHIM
	select DYNAMIC_INTERRUPTS
	select CPP
	select ENTROPY_GENERATOR
	select FLASH
	select HWINFO
	help
	  Enable the Bouffalo Lab proprietary Zigbee stack for BL702L.

if BFLB_ZIGBEE

config BFLB_ZIGBEE_LOG_LEVEL
	int "Zigbee shim log level"
	default 3
	range 0 4

config BFLB_ZIGBEE_HEAP_SIZE
	int "Zigbee heap size"
	default 32768
	help
	  Size in bytes of the heap used by the zigbee stack.

config BFLB_ZIGBEE_FLASH_SIZE
	hex "Flash size for zigbee persistent storage"
	default 0x100000

config BFLB_ZIGBEE_MANUFACTURER_ID
	hex "Zigbee manufacturer ID"
	default 0xFFFF

endif # BFLB_ZIGBEE
```

## soc/bflb/bl70xl/Kconfig
```kconfig
# Copyright The Zephyr Project Contributors
# SPDX-License-Identifier: Apache-2.0

choice BFLB_BL70XL_SILICON_REV
	prompt "BL70XL silicon revision"
	default BFLB_BL70XL_REV_A1
	depends on SOC_SERIES_BL70XL
	help
	  Select the BL70XL silicon revision. Affects ROM data layout
	  (bflb_itcm.ld) and the rom_a0/rom_a1 blob selected by the HAL
	  when BLE is enabled. Applies to any BL70XL subsystem that
	  cares about silicon rev, not just Bluetooth.

config BFLB_BL70XL_REV_A0
	bool "A0"

config BFLB_BL70XL_REV_A1
	bool "A1"

endchoice

config BL70XL_PDS_S2RAM
	def_bool PM && DT_HAS_BFLB_PDS_ENABLED
	select BFLB_PDS
	select PM_S2RAM
	select PM_DEVICE
	select FLASH
	select SOC_FLASH_BFLB
	help
	  Enable PDS Level 31 (full SoC reset on wakeup) under Zephyr's
	  suspend-to-RAM framework. CPU register save/restore goes through
	  arch_pm_s2ram_suspend(); this driver handles the BL70xL-specific
	  HBN fastboot flag and peripheral suspend/restore. Selects
	  PM_DEVICE so peripheral drivers are suspended/resumed.

config SOC_SERIES_BL70XL
	select ATOMIC_OPERATIONS_C
	select CACHE_MANAGEMENT
	select CLOCK_CONTROL
	select CODE_DATA_RELOCATION
	select CPU_HAS_ICACHE
	select CPU_HAS_DCACHE
	select FPU
	select GEN_IRQ_VECTOR_TABLE
	select HAS_PM
	select INCLUDE_RESET_VECTOR
	select OTP
	select REGULATOR
	select RISCV
	select RISCV_HAS_CLIC
	select RISCV_MACHINE_TIMER
	select RISCV_NO_MTVAL_ON_FP_TRAP
	select RISCV_NO_MTVAL_ON_FP_TRAP_UNALIGNED
	select RISCV_PRIVILEGED
	select RISCV_VECTORED_MODE
	select SOC_EARLY_INIT_HOOK
	select SOC_PREP_HOOK
	select XIP
```

## soc/bflb/bl808/Kconfig
```kconfig
# Copyright The Zephyr Project Contributors
#
# SPDX-License-Identifier: Apache-2.0

config SOC_SERIES_BL808
	select RISCV

config SOC_BL808_M0
	bool
	select CACHE_MANAGEMENT
	select CLOCK_CONTROL
	select CODE_DATA_RELOCATION
	select CPU_HAS_DCACHE
	select CPU_HAS_ICACHE
	select CPU_XUANTIE_E907
	select REGULATOR
	select SOC_EARLY_INIT_HOOK
	select SOC_PREP_HOOK
	select SYSCON
	select XIP

config SOC_BL808_D0
	bool
	select GEN_IRQ_VECTOR_TABLE
	select INCLUDE_RESET_VECTOR
	select RISCV_HAS_PLIC
	select RISCV_MACHINE_TIMER
	select RISCV_MACHINE_TIMER_NO_64BIT_MMIO
	select RISCV_PRIVILEGED
	select SOC_EARLY_INIT_HOOK

config SOC_BL808_LP
	bool
	select GEN_IRQ_VECTOR_TABLE
	select INCLUDE_RESET_VECTOR
	select RISCV_HAS_CLIC
	select RISCV_MACHINE_TIMER
	select RISCV_PRIVILEGED
	select RISCV_VECTORED_MODE
	select SOC_EARLY_INIT_HOOK
```

## soc/bflb/bl808x/Kconfig.soc
```kconfig
# Copyright The Zephyr Project Contributors
#
# SPDX-License-Identifier: Apache-2.0

config SOC_SERIES_BL808X
	bool
	select SOC_FAMILY_BFLB
	help
	  Enable support for BouffaloLab BL808 MCU series

config SOC_SERIES
	default "bl808x" if SOC_SERIES_BL808X

config SOC_BL808
	bool
	select SOC_SERIES_BL808X

config SOC
	default "bl808" if SOC_BL808
```

## soc/bflb/bl808x/wifi/Kconfig
```kconfig
# Copyright The Zephyr Project Contributors
# SPDX-License-Identifier: Apache-2.0

config WIFI_BL808X
	bool "BL808 WiFi host driver support"
	default y
	depends on WIFI_BFLB
	select DYNAMIC_INTERRUPTS
	help
	  Enable the BL808 WiFi host driver layer (OS adapter, IPC,
	  utilities). This is selected automatically when the WiFi
	  driver is enabled.
```

## soc/bflb/common/Kconfig
```kconfig
# Copyright The Zephyr Project Contributors
# SPDX-License-Identifier: Apache-2.0

config BFLB_PDS
	bool
	help
	  Shared, SoC-agnostic parts of the BFLB PDS deep-sleep support
	  (HBN-RTC/mtimer timekeeping, RC32K calibration policy, gpio-keys
	  wake reporting). Selected by a per-SoC PDS implementation.
```
