## dts/bindings/audio/bflb,auadc.yaml
```yaml
# Copyright The Zephyr Project Contributors
# SPDX-License-Identifier: Apache-2.0

description: |
  Bouffalo Lab AUADC (Audio ADC) controller with analog and PDM input.
  Supports analog microphone input via integrated PGA/ADC and digital
  PDM microphone input. Only one input mode is active at a time.

compatible: "bflb,auadc"

include: base.yaml

properties:
  reg:
    required: true

  interrupts:
    required: true

  dmas:
    required: true
    description: |
      RX DMA specifier. Each specifier has a phandle to the DMA controller,
      a channel number, and a peripheral trigger source.

  dma-names:
    required: true
    description: Must be "rx".

  input-mode:
    type: string
    default: "adc"
    enum:
      - "adc"
      - "pdm-left"
      - "pdm-right"
    description: |
      Audio input mode.
      adc: Analog ADC input via integrated PGA (BL616/BL618/BL702L only)
      pdm-left: PDM digital microphone, left channel
      pdm-right: PDM digital microphone, right channel
```

## dts/bindings/audio/bflb,audac.yaml
```yaml
# Copyright The Zephyr Project Contributors
# SPDX-License-Identifier: Apache-2.0

description: Bouffalo Lab AUDAC (Audio DAC) controller

compatible: "bflb,audac"

include: [base.yaml, pinctrl-device.yaml]

properties:
  reg:
    required: true

  interrupts:
    required: true

  pinctrl-0:
    required: true

  pinctrl-names:
    required: true

  output-mode:
    type: string
    default: "pwm"
    enum:
      - "pwm"
      - "gpdac-a"
      - "gpdac-b"
      - "gpdac-ab"
    description: |
      Audio DAC output mode.
      pwm: Direct PWM output on GPIO pins
      gpdac-a: Route to GPDAC channel A
      gpdac-b: Route to GPDAC channel B
      gpdac-ab: Route to both GPDAC channels
```

## dts/bindings/clock/bflb,bl808x-clock-controller.yaml
```yaml
# Copyright The Zephyr Project Contributors
# SPDX-License-Identifier: Apache-2.0

description: Bouffalolab BL808x Clock Controller

compatible: "bflb,bl808x-clock-controller"

include: [base.yaml, clock-controller.yaml]

properties:
  "#clock-cells":
    const: 1

clock-cells:
  - id
```

## dts/bindings/clock/bflb,f32k.yaml
```yaml
# Copyright The Zephyr Project Contributors
# SPDX-License-Identifier: Apache-2.0

description: Bouffalo Labs F32K clock (selects between rc32k and xtal32k)

compatible: "bflb,f32k"

include: [base.yaml, clock-controller.yaml]

properties:
  clocks:
    type: phandle-array
    required: true
    description: Source clock (rc32k or xtal32k)

  "#clock-cells":
    const: 0
```

## dts/bindings/clock/bflb,pll.yaml
```yaml
# Copyright The Zephyr Project Contributors
# SPDX-License-Identifier: Apache-2.0

description: Generic Bouffalo Labs PLL

compatible: "bflb,pll"

include: [base.yaml, clock-controller.yaml]

properties:
  clocks:
    type: phandle-array
    required: true
    description: PLL reference clock source

  top-frequency:
    type: int
    required: true
    description: Maximum VCO output frequency in Hz

  "#clock-cells":
    const: 1

clock-cells:
  - select
```

## dts/bindings/clock/bflb,root-clk.yaml
```yaml
# Copyright The Zephyr Project Contributors
# SPDX-License-Identifier: Apache-2.0

description: |
  Generic Bouffalo Labs Root Clock
  Represents both FCLK and HCLK, which should be kept the same.
  Source -> FCLK / divider -> HCLK / divider -> BCLK

  'clocks' take the form of:
  clocks = <&clk_wifipll PLL_ID>;
  Where the phandle is one of clk_wifipll, clk_aupll, clk_crystal, or clk_rc32m.

compatible: "bflb,root-clk"

include: [base.yaml, clock-controller.yaml]

properties:
  clocks:
    type: phandle-array
    required: true
    description: source

  divider:
    type: int
    required: true
    description: Divide source clock by this 8-bits value (FCLK divider). Typically 1.

  "#clock-cells":
    const: 0
```

## dts/bindings/dac/bflb,gpdac.yaml
```yaml
# Copyright The Zephyr Project Contributors
# SPDX-License-Identifier: Apache-2.0

description: |
  Bouffalo Lab General-Purpose DAC (GPDAC).

  Two-channel DAC with 10-bit resolution. Channel 0 is GPDAC-A,
  channel 1 is GPDAC-B. The reg property points to the GPIP base
  address which contains the DAC FIFO and config registers. The GLB
  registers for channel control are accessed via the SoC GLB_BASE.

compatible: "bflb,gpdac"

include: [base.yaml, dac-controller.yaml]

properties:
  reg:
    required: true

  "#io-channel-cells":
    const: 1
```

## dts/bindings/gpio/bflb,bl61x_808x-gpio.yaml
```yaml
# Copyright The Zephyr Project Contributors
# SPDX-License-Identifier: Apache-2.0

description: BouffaloLab GPIO node for BL61X and BL808X series

compatible: "bflb,bl61x_808x-gpio"

include:
  - name: base.yaml
  - name: gpio-controller.yaml

properties:
  reg:
    required: true

  interrupts:
    required: true

  "#gpio-cells":
    const: 2

gpio-cells:
  - pin
  - flags
```

## dts/bindings/i2s/bflb,i2s.yaml
```yaml
# Copyright The Zephyr Project Contributors
# SPDX-License-Identifier: Apache-2.0

description: Bouffalo Lab I2S controller

compatible: "bflb,i2s"

include: [i2s-controller.yaml, pinctrl-device.yaml]

properties:
  reg:
    required: true

  interrupts:
    required: true

  dmas:
    required: true
    description: |
      DMA specifiers for TX and RX channels. Each specifier has a phandle
      to the DMA controller, a channel number, and a peripheral trigger source.
      Both TX and RX must be supplied; the driver currently requires both
      DMA channels to be ready at init even when only one direction is used.

      Peripheral trigger source IDs depend on the SoC:
        BL702/BL706: TX=0x15, RX=0x14
        BL616/BL618: TX=0x11, RX=0x10

      Example for BL616/BL618:
        dmas = <&dma0 0 0x11>, <&dma0 1 0x10>;
        dma-names = "tx", "rx";

  dma-names:
    required: true
    description: DMA channel names. Must include both "tx" and "rx".

  pinctrl-0:
    required: true

  pinctrl-names:
    required: true

  clock-frequency:
    type: int
    description: |
      I2S peripheral source clock frequency in Hz. The I2S source on
      Bouffalo Lab SoCs is the audio PLL (AUPLL) — its rate is not
      currently exposed by the Zephyr clock controller, so it must be
      passed in here when the bootloader has configured AUPLL to a known
      frequency. If omitted, the driver falls back to the system tick
      clock as a (likely incorrect) guess and will produce audio at the
      wrong sample rate.
```

## dts/bindings/ieee802154/bflb,ieee802154.yaml
```yaml
# Copyright The Zephyr Project Contributors
# SPDX-License-Identifier: Apache-2.0

description: Bouffalo Lab IEEE 802.15.4 node

compatible: "bflb,ieee802154"

include: base.yaml

properties:
  reg:
    required: true

  interrupts:
    required: true
```

## dts/bindings/memory-controllers/bflb,bl808x-psram.yaml
```yaml
# Copyright The Zephyr Project Contributors
# SPDX-License-Identifier: Apache-2.0

description: BL808x pseudo-static RAM controller

compatible: "bflb,bl808x-psram"

include: base.yaml

properties:
  clock-divider:
    type: int
    required: true
    enum:
      - 1
      - 2
      - 3
      - 4
    description: Divide PLL div1 (WIFIPLL 320M or AUPLL) by this to PSRAM clock
```

## dts/bindings/misc/bflb,bl61x-pec.yaml
```yaml
# Copyright The Zephyr Project Contributors
# SPDX-License-Identifier: Apache-2.0

title: Bouffalo Lab PEC (Programmable Engine/Controller)

description: |
  A programmable I/O state-machine block on the BL61x SoCs. It provides four
  state machines sharing a 32-entry instruction memory, driven through the API
  in <zephyr/drivers/misc/pec_bflb/pec_bflb.h>.

compatible: "bflb,bl61x-pec"

include: [base.yaml, pinctrl-device.yaml]

properties:
  reg:
    required: true

  interrupts:
    description: |
      The two PEC interrupt lines (interrupt group 0 and group 1). The current
      driver operates the FIFOs by polling and does not use these.

  pinctrl-0:
    required: true

  pinctrl-names:
    required: true
```

## dts/bindings/power/bflb,pds.yaml
```yaml
# Copyright The Zephyr Project Contributors
#
# SPDX-License-Identifier: Apache-2.0

title: Bouffalolab Power Down Sleep (PDS) controller

description: |
  The PDS block is a memory-mapped sleep/power-gating controller present on
  all Bouffalolab SoCs (BL60x, BL70x, BL70xL, BL61x, BL618, BL808). It
  owns a small bank of control registers that select which power domains
  to gate or power off, a 32 kHz sleep counter, a programmable set of
  wake sources, and a dedicated CLIC interrupt line.

  The driver backing this binding is the SoC entry/exit path for Zephyr
  power-states declared under cpus/*/cpu-power-states. When the PM
  framework decides the CPU should enter a deep state, it calls into the
  PDS driver, which composes a per-level configuration, arms the wake
  source, and issues wfi. On wake (either abort or full reset) the
  driver restores clock, flash XIP and CPU state and hands control back
  to the kernel.

  The per-level control word is SoC-specific because the bit meanings
  inside PDS_CTL differ across the family; those tables live in the SoC
  layer, not the binding.

compatible: "bflb,pds"

include: base.yaml

properties:
  reg:
    required: true

  interrupts:
    required: true
    description: |
      PDS wake-up interrupt line (e.g. CLIC irq 66 on BL70xL).

  interrupt-names:
    required: true
    description: |
      Must include "wakeup" for the main PDS wake interrupt.

  wakeup-gpios:
    type: phandle-array
    description: |
      GPIO pins that can wake the SoC from PDS sleep. The wake trigger
      depends on which power domain the pin belongs to and the driver
      does not use the active-level flag:
        - HBN-domain pins (GPIO 9-13, 30-31) wake on a falling edge
          (asynchronous), routed through the HBN wake logic.
        - All other pins are armed as PDS IO wake sources with
          both-edge detection.

examples:
  - |
    /*
     * BL70xL PDS peripheral: reg block at 0x4000e000, wake on
     * CLIC interrupt 66. Boards set status = "okay" to use
     * deep-sleep states, or "disabled" to fall back to CPU idle.
     */
    pds: power-downsleep@4000e000 {
            compatible = "bflb,pds";
            reg = <0x4000e000 0x1000>;
            interrupts = <66 0>;
            interrupt-parent = <&clic>;
            interrupt-names = "wakeup";
            status = "okay";
    };
```

## dts/bindings/sdhc/bflb,bl808x-sdhc.yaml
```yaml
# Copyright The Zephyr Project Contributors
# SPDX-License-Identifier: Apache-2.0

description: Bouffalo Lab BL808 SD Host Controller

compatible: "bflb,bl808x-sdhc"

include: [sdhc.yaml, pinctrl-device.yaml]

properties:
  reg:
    required: true

  interrupts:
    required: true

  clocks:
    required: true

  bus-width:
    type: int
    default: 4
    description: |
      Data bus width. 1 for 1-bit, 4 for 4-bit.
    enum:
      - 1
      - 4
```

## dts/bindings/sensor/bosch,bmv080.yaml
```yaml
# Copyright The Zephyr Project Contributors
# SPDX-License-Identifier: Apache-2.0

description: |
  Bosch BMV080 particulate matter (PM) sensor.
  The BMV080 is a photoacoustic PM sensor that measures PM1, PM2.5,
  and PM10 mass concentrations. It communicates via I2C using 16-bit
  register addresses with 16-bit word payloads.

  The default I2C address is 0x57. Up to four addresses are selectable
  via external strapping pins (0x57, 0x56, 0x55, 0x54).

  Example:

    &i2c0 {
        bmv080@57 {
            compatible = "bosch,bmv080";
            reg = <0x57>;
        };
    };

compatible: "bosch,bmv080"

include: [sensor-device.yaml, i2c-device.yaml]

properties:
  reg:
    required: true
    description: |
      I2C address of the BMV080 sensor.
      Possible values: 0x54, 0x55, 0x56, 0x57.
      Default is 0x57.
```

## dts/bindings/sensor/meas,htu21d.yaml
```yaml
# Copyright The Zephyr Project Contributors
# SPDX-License-Identifier: Apache-2.0

description: |
  TE Connectivity HTU21D digital humidity and temperature sensor.
  Communicates via I2C at fixed address 0x40.

compatible: "meas,htu21d"

include: [sensor-device.yaml, i2c-device.yaml]

examples:
  - |
    i2c {
      #address-cells = <1>;
      #size-cells = <0>;

      htu21d@40 {
        compatible = "meas,htu21d";
        reg = <0x40>;
      };
    };
```

## dts/bindings/sensor/meas,htu41d.yaml
```yaml
# Copyright The Zephyr Project Contributors
# SPDX-License-Identifier: Apache-2.0

description: |
  TE Connectivity HTU41D digital humidity and temperature sensor.
  Communicates via I2C at fixed address 0x40.

compatible: "meas,htu41d"

include: [sensor-device.yaml, i2c-device.yaml]

examples:
  - |
    i2c {
      #address-cells = <1>;
      #size-cells = <0>;

      htu41d@40 {
        compatible = "meas,htu41d";
        reg = <0x40>;
      };
    };
```

## dts/bindings/serial/zephyr,cdc-acm-uart.yaml
```yaml
# Copyright (c) 2021 Nordic Semiconductor ASA
# SPDX-License-Identifier: Apache-2.0

description: USB CDC ACM UART

compatible: "zephyr,cdc-acm-uart"

include: uart-controller.yaml

on-bus: usb

properties:
  tx-fifo-size:
    type: int
    default: 1024
    description: |
      Size of the virtual CDC ACM UART TX FIFO

  tx-buf-size:
    type: int
    description: |
      Size of each TX FIFO buffer, a multiple of the bulk endpoint MPS.
      Each buffer is sent as one IN transfer, so buffers larger than the
      MPS reduce the per-transfer overhead. Defaults to the bulk endpoint
      MPS (512 bytes when high-speed is supported, 64 bytes otherwise).

  rx-fifo-size:
    type: int
    default: 1024
    description: |
      Size of the virtual CDC ACM UART RX FIFO

  label:
    description: |
      The string defined by the label property is also used for the USB
      interface string descriptor.
```

## dts/bindings/usb/bflb,bl808x-udc.yaml
```yaml
# SPDX-FileCopyrightText: Copyright The Zephyr Project Contributors
# SPDX-License-Identifier: Apache-2.0

description: Bouffalo Lab BL808x USB 2.0 device controller (Full-Speed)

compatible: "bflb,bl808x-udc"

include: [usb-controller.yaml]

properties:
  reg:
    required: true
    description: USB controller registers

  interrupts:
    required: true
```

## dts/bindings/usb/bflb,udc-2.yaml
```yaml
# SPDX-FileCopyrightText: Copyright The Zephyr Project Contributors
# SPDX-License-Identifier: Apache-2.0

description: Bouffalo Lab USB V2 device controller

compatible: "bflb,udc-2"

include: [usb-controller.yaml]

properties:
  reg:
    required: true
    description: USB controller registers

  interrupts:
    required: true
```
