## dts/bindings/video/bflb,camfront.yaml
```yaml
# Copyright The Zephyr Project Contributors
# SPDX-License-Identifier: Apache-2.0

description: |
  Bouffalo Lab camera front end.

  The front end receives the parallel bus of the sensor and feeds it to the
  capture interface, after buffering each line to cross into the capture
  clock domain. It also drives the sensor reference clock (MCLK) from one of
  the chip clock outputs, which is selected through its pinctrl state.

  A compressed (JPEG) stream needs a second pinctrl state, named "compressed",
  that takes the frame sync (VSYNC) pin away from the front end, for instance
  as a plain GPIO input. The stream is then captured as a single endless frame,
  as the capture interface stalls on the frame ends of a compressed stream.

compatible: "bflb,camfront"

include: [base.yaml, pinctrl-device.yaml]

properties:
  reg:
    required: true

  pinctrl-0:
    required: true

  pinctrl-names:
    required: true

  clocks:
    required: true
    description: |
      The capture clock, named "core", and the reference clock driven out to the
      sensor, named "ref".

  clock-names:
    required: true

  mclk-frequency:
    type: int
    default: 24000000
    description: |
      Rate the reference clock is driven out to the sensor at. The clock
      controller composes it from whichever of its sources can produce it.

  pclk-frequency:
    type: int
    default: 24000000
    description: |
      Pixel clock rate the sensor drives on PCLK, for a sensor that does not
      report its pixel rate. Used, together with the capture clock rate, to
      size the amount of pixel data buffered ahead of the capture interface.

  source:
    type: phandle
    required: true
    description: Image sensor feeding the parallel bus.

child-binding:
  child-binding:
    include: video-interfaces.yaml

    properties:
      reg:
        type: array
        required: true
        description: Endpoint 0 is the sensor input, endpoint 1 the capture interface output.
```

## dts/bindings/video/bflb,dvp.yaml
```yaml
# Copyright The Zephyr Project Contributors
# SPDX-License-Identifier: Apache-2.0

description: |
  Bouffalo Lab DVP camera interface.

  The controller writes captured frames straight to memory over AXI. The sensor
  reference clock (MCLK) is driven by one of the chip clock outputs, which is
  selected through the pinctrl state of this node.

compatible: "bflb,dvp"

include: [base.yaml, pinctrl-device.yaml]

properties:
  reg:
    required: true

  interrupts:
    required: true

  pinctrl-0:
    required: true

  pinctrl-names:
    required: true

  clocks:
    required: true
    description: |
      The capture clock, named "core", and the reference clock driven out to the
      sensor, named "ref".

  clock-names:
    required: true

  mclk-frequency:
    type: int
    default: 24000000
    description: |
      Rate the reference clock is driven out to the sensor at. The clock
      controller composes it from whichever of its sources can produce it.

  source:
    type: phandle
    required: true
    description: Image sensor feeding the parallel bus.

  pclk-frequency:
    type: int
    default: 24000000
    description: |
      Pixel clock rate the sensor drives on PCLK. Used, together with the
      capture clock rate, to size the amount of pixel data buffered ahead of
      the AXI write burst.

child-binding:
  child-binding:
    include: video-interfaces.yaml
```

## dts/bindings/video/bflb,dvp2axi.yaml
```yaml
# Copyright The Zephyr Project Contributors
# SPDX-License-Identifier: Apache-2.0

description: |
  Bouffalo Lab DVP camera capture interface.

  The controller writes the frames it receives from the camera front end
  straight to memory over AXI.

compatible: "bflb,dvp2axi"

include: base.yaml

properties:
  reg:
    required: true

  interrupts:
    required: true

  source:
    type: phandle
    required: true
    description: Camera front end feeding the capture interface.

child-binding:
  child-binding:
    include: video-interfaces.yaml
```

## dts/bindings/video/bflb,mjpeg.yaml
```yaml
# Copyright The Zephyr Project Contributors
# SPDX-License-Identifier: Apache-2.0

description: |
  Bouffalo Lab MJPEG encoder.

  The encoder reads raw frames from memory and writes them back as JPEG images,
  header included.

compatible: "bflb,mjpeg"

include: base.yaml

properties:
  reg:
    required: true

  interrupts:
    required: true
```

## dts/bindings/wifi/bflb,bl808-wifi.yaml
```yaml
# SPDX-FileCopyrightText: Copyright The Zephyr Project Contributors
#
# SPDX-License-Identifier: Apache-2.0

description: Bouffalo Lab BL808 WiFi MAC

compatible: "bflb,bl808-wifi"

include: base.yaml

properties:
  interrupts:
    required: true
    description: |
      WiFi MAC and IPC interrupts.
      Two entries required: "wifi" (MAC) and "wifi-ipc" (IPC mailbox).

  interrupt-names:
    required: true

  pwr-table-11b:
    type: array
    description: |
      TX power targets for 802.11b rates (1, 2, 5.5, 11 Mbps).
      4 entries, units are dBm.

  pwr-table-11g:
    type: array
    description: |
      TX power targets for 802.11g rates (6..54 Mbps).
      8 entries, units are dBm.

  pwr-table-11n-ht20:
    type: array
    description: |
      TX power targets for 802.11n HT20 (MCS 0-7).
      8 entries, units are dBm.

  xtal-capcode-in:
    type: int
    description: XTAL input capacitor code.

  xtal-capcode-out:
    type: int
    description: XTAL output capacitor code.
```
